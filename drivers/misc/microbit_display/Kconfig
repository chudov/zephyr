## drivers/misc/microbit_display/Kconfig
```kconfig
# Microbit display driver configuration options

# Copyright (c) 2017 Jan Van Winkel <jan.van_winkel@dxplore.eu>
# Copyright (c) 2021 Peter Niebert <peter.niebert@univ-amu.fr>
# SPDX-License-Identifier: Apache-2.0

config MICROBIT_DISPLAY
	bool "BBC micro:bit 5x5 LED Display support"
	depends on (BOARD_BBC_MICROBIT || BOARD_BBC_MICROBIT_V2)
	help
	  Enable this to be able to display images and text on the 5x5
	  LED matrix display on the BBC micro:bit.

if MICROBIT_DISPLAY

config MICROBIT_DISPLAY_STR_MAX
	int "Maximum length of strings that can be shown on the display"
	range 3 255
	default 40
	help
	  This value specifies the maximum length of strings that can
	  be displayed using the mb_display_string() and mb_display_print()
	  APIs.

config MICROBIT_DISPLAY_TIMER_PRIORITY
	int "NRFX Timer Interrupt priority"
	default 1
	help
		Priority of the refresh interrupt of the
		LED matrix. Can probably be low as it is not
		critical.

config MICROBIT_DISPLAY_REFRESH_RATE_HZ
	int "Display refresh rate in [Hz]"
	range 10 2500
	default 100
	help
		Display refresh rate in Hz. Higher rate leads
		to higher CPU load.

choice MICROBIT_DISPLAY_TIMER
		prompt "NRFX Hardware Timer"
		default MICROBIT_DISPLAY_TIMER3
		help
			Select the hardware timer instance used by this driver.
			Support of the selected timer will be enabled automatically.
			Beware of conflicts with other drivers, e.g. for bluetooth.

# force activation of chosen timer

config MICROBIT_DISPLAY_TIMER0
		bool "TIMER0"
		depends on HAS_HW_NRF_TIMER0
		depends on !NRF_HW_TIMER0_RESERVED
		select NRFX_TIMER
		select NRFX_TIMER0

config MICROBIT_DISPLAY_TIMER1
		bool "TIMER1"
		depends on HAS_HW_NRF_TIMER1
		depends on !NRF_HW_TIMER1_RESERVED
		select NRFX_TIMER
		select NRFX_TIMER1

config MICROBIT_DISPLAY_TIMER2
		bool "TIMER2"
		depends on HAS_HW_NRF_TIMER2
		depends on !NRF_HW_TIMER2_RESERVED
		select NRFX_TIMER
		select NRFX_TIMER2

config MICROBIT_DISPLAY_TIMER3
		bool "TIMER3"
		depends on HAS_HW_NRF_TIMER3
		depends on !NRF_HW_TIMER3_RESERVED
		select NRFX_TIMER
		select NRFX_TIMER3

config MICROBIT_DISPLAY_TIMER4
		bool "TIMER4"
		depends on HAS_HW_NRF_TIMER4
		depends on !NRF_HW_TIMER4_RESERVED
		select NRFX_TIMER
		select NRFX_TIMER4

endchoice

endif
```
